## package/asterisk-chan-dongle/Config.in
```kconfig
config BR2_PACKAGE_ASTERISK_CHAN_DONGLE
	bool "asterisk-chan-dongle"
    depends on BR2_PACKAGE_ASTERISK
  	help
	  The goal of ldns is to simplify DNS programming, it supports
	  recent RFCs like the DNSSEC documents, and allows developers
	  to easily create software conforming to current RFCs, and
	  experimental software for current Internet Drafts.
```

## package/asterisk-g729/Config.in
```kconfig
config BR2_PACKAGE_ASTERISK_G729
	bool "asterisk-g729"
    depends on BR2_PACKAGE_ASTERISK
	select BR2_PACKAGE_BCG729
```

## package/opendmarc/Config.in
```kconfig
config BR2_PACKAGE_OPENDMARC
	bool "opendmarc"
	select BR2_PACKAGE_LIBMILTER
	select BR2_PACKAGE_LIBSPF2
	help
	  http://www.nlnetlabs.nl/projects/opendkim
```

## package/opendnssec/Config.in
```kconfig
config BR2_PACKAGE_OPENDNSSEC
	bool "opendnssec"
	select BR2_PACKAGE_LIBXML2
	select BR2_PACKAGE_LIBLDNS
	select BR2_PACKAGE_SOFTHSM
	help
	  The goal of ldns is to simplify DNS programming, it supports
	  recent RFCs like the DNSSEC documents, and allows developers
	  to easily create software conforming to current RFCs, and
	  experimental software for current Internet Drafts.

	  http://www.nlnetlabs.nl/projects/opendnssec
```

## package/postfix/Config.in
```kconfig
config BR2_PACKAGE_POSTFIX
	bool "postfix"
	select BR2_PACKAGE_ICU
	depends on BR2_USE_MMU # fork()
```
